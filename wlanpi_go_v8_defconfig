## wlanpi_go_v8_defconfig
```kconfig
CONFIG_LOCALVERSION="-v8-wlanpi"
#
# WLAN Pi Go
#
CONFIG_USB_SUPPORT=y
CONFIG_USB=y
CONFIG_SPI=y
CONFIG_USB_MAX3421_HCD=m
CONFIG_TYPEC=m 
CONFIG_TYPEC_UCSI=m 
CONFIG_TYPEC_UCSI_ACPI=m
CONFIG_TYPEC_UCSI_PLATFORM=m
CONFIG_UCSI_STM32G0=m
CONFIG_USB_ROLE_SWITCH=y
CONFIG_USB_PD=m
CONFIG_I2C=y
```
